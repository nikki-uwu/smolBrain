## firmware_files/smolBrain_rev3/board.yml
```yaml
# Copyright (c) 2024 Nordic Semiconductor ASA
# SPDX-License-Identifier: Apache-2.0

board:
  name: nikkismolbrain_r3_uf2
  vendor: nikki
  socs:
    - name: nrf52833
```
